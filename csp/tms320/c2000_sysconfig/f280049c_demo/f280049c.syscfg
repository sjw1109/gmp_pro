/**
 * These arguments were used when this file was generated. They will be automatically applied on subsequent loads
 * via the GUI or CLI. Run CLI with '--help' for additional information on how to override these arguments.
 * @cliArgs --device "F28004x" --part "F28004x_100PZ" --package "F28004x_100PZ" --context "system" --product "C2000WARE@5.02.00.00"
 * @v2CliArgs --device "TMS320F280049C" --package "100PZ" --context "system" --product "C2000WARE@5.02.00.00"
 * @versions {"tool":"1.22.0+3893"}
 */

/**
 * Import the modules used in this configuration.
 */
const adc            = scripting.addModule("/driverlib/adc.js", {}, false);
const adc1           = adc.addInstance();
const adc2           = adc.addInstance();
const adc3           = adc.addInstance();
const asysctl        = scripting.addModule("/driverlib/asysctl.js");
const device_support = scripting.addModule("/driverlib/device_support.js");
const memcfg         = scripting.addModule("/driverlib/memcfg.js");
const sysctl         = scripting.addModule("/driverlib/sysctl.js");
const CMD            = scripting.addModule("/utilities/cmd_tool/cmd_syscfg/source/CMD", {}, false);
const CMD1           = CMD.addInstance();

/**
 * Write custom configuration values to the imported modules.
 */
adc1.$name                          = "ADC_CHA";
adc1.adcClockPrescaler              = "ADC_CLK_DIV_2_0";
adc1.socHighPriorityMode            = "ADC_PRI_THRU_SOC2_HIPRI";
adc1.enabledSOCs                    = ["ADC_SOC_NUMBER0","ADC_SOC_NUMBER1","ADC_SOC_NUMBER2"];
adc1.soc0Channel                    = "ADC_CH_ADCIN9";
adc1.soc0Name                       = "IC";
adc1.soc0SampleWindow               = 8;
adc1.soc1Name                       = "VC";
adc1.soc1Channel                    = "ADC_CH_ADCIN10";
adc1.soc0Trigger                    = "ADC_TRIGGER_EPWM1_SOCA";
adc1.soc1SampleWindow               = 8;
adc1.soc1Trigger                    = "ADC_TRIGGER_EPWM1_SOCA";
adc1.soc2Channel                    = "ADC_CH_ADCIN5";
adc1.soc2Trigger                    = "ADC_TRIGGER_EPWM1_SOCA";
adc1.soc2SampleWindow               = 8;
adc1.soc2Name                       = "Udc";
adc1.interruptPulseMode             = "ADC_PULSE_END_OF_CONV";
adc1.enabledInts                    = ["ADC_INT_NUMBER1"];
adc1.enableInterrupt1ContinuousMode = true;
adc1.enableInterrupt1               = true;
adc1.interrupt1SOCSource            = "ADC_SOC_NUMBER1";
adc1.ppb2SOCNumber                  = "ADC_SOC_NUMBER1";
adc1.ppb3SOCNumber                  = "ADC_SOC_NUMBER2";
adc1.ppb1Name                       = "PPB_IC";
adc1.registerInterrupts             = ["1"];
adc1.adcInt1.interruptHandler       = "MainCtrlISR";
adc1.adcInt1.$name                  = "INT_ADC_CHA_1";
adc1.adcInt1.enableInterrupt        = true;

adc2.adcBase             = "ADCB_BASE";
adc2.$name               = "ADC_CHB";
adc2.adcClockPrescaler   = "ADC_CLK_DIV_2_0";
adc2.enabledSOCs         = ["ADC_SOC_NUMBER0","ADC_SOC_NUMBER1","ADC_SOC_NUMBER2"];
adc2.soc0Name            = "IA";
adc2.soc0Channel         = "ADC_CH_ADCIN2";
adc2.soc0Trigger         = "ADC_TRIGGER_EPWM1_SOCA";
adc2.soc0SampleWindow    = 8;
adc2.soc1Name            = "VA";
adc2.soc1Trigger         = "ADC_TRIGGER_EPWM1_SOCA";
adc2.soc1SampleWindow    = 8;
adc2.soc2Name            = "Tc";
adc2.soc2Channel         = "ADC_CH_ADCIN3";
adc2.soc2Trigger         = "ADC_TRIGGER_EPWM1_SOCA";
adc2.soc2SampleWindow    = 8;
adc2.socHighPriorityMode = "ADC_PRI_THRU_SOC1_HIPRI";

adc3.adcBase             = "ADCC_BASE";
adc3.$name               = "ADC_CHC";
adc3.adcClockPrescaler   = "ADC_CLK_DIV_2_0";
adc3.socHighPriorityMode = "ADC_PRI_THRU_SOC1_HIPRI";
adc3.enabledSOCs         = ["ADC_SOC_NUMBER0","ADC_SOC_NUMBER1"];
adc3.soc0SampleWindow    = 8;
adc3.soc1SampleWindow    = 8;
adc3.soc1Channel         = "ADC_CH_ADCIN2";
adc3.soc0Name            = "IB";
adc3.soc1Name            = "VB";
adc3.soc0Trigger         = "ADC_TRIGGER_EPWM1_SOCA";
adc3.soc1Trigger         = "ADC_TRIGGER_EPWM1_SOCA";

const divider1       = system.clockTree["CLBCLKDIV"];
divider1.divideValue = 8;

const mux4       = system.clockTree["XTAL_OR_X1"];
mux4.inputSelect = "X1";

CMD1.$name = "CMD0";
